#include <behaviors.dtsi>
#include <dt-bindings/zmk/keys.h>

/ {
    keymap {
        compatible = "zmk,keymap";
        Base {
            label = "Base";
            bindings = <
**yasui base**
            >;
        };
    };
};
